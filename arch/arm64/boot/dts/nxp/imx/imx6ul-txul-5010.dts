// SPDX-License-Identifier: GPL-2.0-only OR MIT
/* Ka-Ro electronics TXUL-5010 module (i.MX6UL, NAND). */

/dts-v1/;

#include "imx6ul.dtsi"
#include "imx6ul-txul.dtsi"

/ {
	model = "Ka-Ro electronics TXUL-5010 Module";
	compatible = "karo,imx6ul-tx6ul", "fsl,imx6ul";

	aliases {
		/delete-property/ mmc1;
	};
};
