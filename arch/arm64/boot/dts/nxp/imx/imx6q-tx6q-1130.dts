// SPDX-License-Identifier: GPL-2.0-only OR MIT
/* Ka-Ro electronics TX6Q-1130: same board as the TX6Q-1110, 1 GiB DDR3. */

/dts-v1/;

#include "imx6q-tx6q-1110.dts"

/ {
	model = "Ka-Ro electronics TX6Q-1130 Module";
};
