// SPDX-License-Identifier: (GPL-2.0 OR MIT)
/*
 * Copyright 2021 Markus Bauer <MB@KARO-electronics.de>
 *
 */

#include "imx8mm-tx8m-1620-lvds-mb.dts"
#include "imx8mm-tx8m-ath9k-wifi.dtsi"

/ {
	model = "Ka-Ro TX8M-1620 module on TX-LVDS Mainboard with ATH9K Wifi";
};
