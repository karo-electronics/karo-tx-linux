// SPDX-License-Identifier: (GPL-2.0 OR MIT)
/*
 * Copyright (C) 2022 Markus Bauer <MB@KARO-electronics.de>
 *
 */

/dts-v1/;

#include "imx8mm-qsxm-mm60-qsbase4.dts"
#include "imx8m-qs8m-raspi-display.dtsi"

/ {
	model = "Ka-Ro electronics QSXM-MM60 (NXP i.MX8MM) module on QSBASE4 baseboard with Raspi Display";
};

&vpu_g1 {
	status = "okay";
};

&vpu_g2 {
	status = "okay";
};

&vpu_h1 {
	status = "okay";
};
