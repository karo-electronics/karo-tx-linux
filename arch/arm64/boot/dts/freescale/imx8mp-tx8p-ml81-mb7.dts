// SPDX-License-Identifier: (GPL-2.0 OR MIT)
/*
 * Copyright (C) 2021 Lothar Waßmann <LW@KARO-electronics.de>
 */

/dts-v1/;

#include "imx8mp-tx8p-ml81.dts"
#include "imx8mp-tx8p-mb7.dtsi"

/ {
	model = "Ka-Ro electronics TX8P-ML81 (NXP i.MX8MP) module on MB7 mainboard";
};
