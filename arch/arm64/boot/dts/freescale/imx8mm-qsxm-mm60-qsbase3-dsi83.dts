// SPDX-License-Identifier: (GPL-2.0 OR MIT)
/*
 * Copyright (C) 2021 Markus Bauer <MB@KARO-electronics.de>
 *
 */

/dts-v1/;

#include "imx8mm-qsxm-mm60-qsbase3.dts"
#include "imx8m-qs8m-dsi83.dtsi"

/ {
	model = "Ka-Ro electronics QSXM-MM60 (NXP i.MX8MM) module on QSBASE3 baseboard with DSI83 MIPI2LVDS bridge";
};

&vpu_g1 {
	status = "okay";
};

&vpu_g2 {
	status = "okay";
};

&vpu_h1 {
	status = "okay";
};
