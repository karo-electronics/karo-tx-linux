// SPDX-License-Identifier: (GPL-2.0 OR MIT)
/*
 * Copyright (C) 2025 Lothar Waßmann <LW@KARO-electronics.de>
 *
 */

/dts-v1/;
/plugin/;

#include <dt-bindings/clock/imx8mm-clock.h>

&{/chosen} {
	overlays {
		bd718xx-restart;
	};
};

&pmic {
	rohm,restart-with-swreset;
	rohm,restart-handler-priority = <130>;
	clocks = <&clk IMX8MM_CLK_I2C1_ROOT>;
};
