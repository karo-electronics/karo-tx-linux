// SPDX-License-Identifier: (GPL-2.0+ OR MIT)
/*
 * Copyright 2026 Lothar Waßmann <LW@KARO-electronics.de>
 * based on: imx91-11x11-evk-ld.dts Copyright 2024 NXP
 */

/dts-v1/;
/plugin/;

#include <dt-bindings/clock/imx91-clock.h>

&lpm {
	no-od-mode;
	ld-mode-enabled;
	soc-supply = <&reg_vdd_soc>;
	status = "okay";
};

&usdhc1 {
	assigned-clocks = <&clk IMX91_CLK_USDHC1>;
	assigned-clock-parents = <&clk IMX91_CLK_SYS_PLL_PFD1>;
	assigned-clock-rates = <266000000>;
};

&usdhc2 {
	assigned-clocks = <&clk IMX91_CLK_USDHC2>;
	assigned-clock-parents = <&clk IMX91_CLK_SYS_PLL_PFD1>;
	assigned-clock-rates = <266000000>;
};
