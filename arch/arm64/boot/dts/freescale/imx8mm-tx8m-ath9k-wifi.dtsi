// SPDX-License-Identifier: (GPL-2.0 OR MIT)
/*
 * Copyright (C) 2021 Markus Bauer <MB@KARO-electronics.de>
 *
 */

&pcie0 {
	status = "okay";

	wifi@168c,002d {
		compatible = "pci168c,0033";
		reg = <0x7000 0 0 0 0x1000>;
		qca,no-eeprom;
	};
};
