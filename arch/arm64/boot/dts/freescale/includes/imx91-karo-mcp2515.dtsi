// SPDX-License-Identifier: (GPL-2.0 OR BSD-3-Clause)
/*
 * Copyright (C) 2023 Lothar Waßmann <LWKARO-electronics.de>
 */

&{/} {
	mcp_clock: mcp-clock {
		compatible = "fixed-clock";
		#clock-cells = <0>;
		clock-frequency = <16000000>;
	};
};
