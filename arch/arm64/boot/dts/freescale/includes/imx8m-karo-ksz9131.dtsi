// SPDX-License-Identifier: (GPL-2.0 OR MIT)
/*
 * Copyright 2022 Lothar Waßmann <LW@KARO-electronics.de>
 *
 */

#include <dt-bindings/interrupt-controller/irq.h>
#include <dt-bindings/gpio/gpio.h>

&fec1 {
	phy-handle = <&ethphy1>;
	phy-supply = <&reg_vdd_3v3>;
	phy-mode = "rgmii-id";
	phy-reset-gpios = <&gpio4 22 GPIO_ACTIVE_LOW>;
	phy-reset-duration = <25>;
	phy-reset-post-delay = <100>;
	status = "okay";

	mdio {
		#address-cells = <1>;
		#size-cells = <0>;

		ethphy1: ethernet-phy@7 {
			reg = <7>;
			micrel,force-master;
			pinctrl-names = "default";
			pinctrl-0 = <&pinctrl_etnphy_int_b>;
			interrupt-parent = <&gpio1>;
			interrupts = <10 IRQ_TYPE_EDGE_FALLING>;
		};
	};
};
