// SPDX-License-Identifier: (GPL-2.0 OR MIT)
/*
 * Copyright 2022 Lothar Waßmann <LW@KARO-electronics.de>
 *
 */

#include <dt-bindings/interrupt-controller/irq.h>
#include <dt-bindings/gpio/gpio.h>

&fec1 {
	phy-handle = <&ethphy0>;
	phy-mode = "rgmii-id";
	status = "okay";

	mdio {
		clock-frequency = <8000000>;
		reset-gpios = <&gpio4 22 GPIO_ACTIVE_LOW>;
		reset-delay-us = <10000>;
		reset-post-delay-us = <100>;
		#address-cells = <1>;
		#size-cells = <0>;

		ethphy0: ethernet-phy@3 {
			reg = <3>;
			pinctrl-names = "default";
			pinctrl-0 = <&pinctrl_etnphy_int_b>;
			interrupt-parent = <&gpio1>;
			interrupts = <10 IRQ_TYPE_EDGE_FALLING>;
			micrel,force-master;
		};
	};
};
