// SPDX-License-Identifier: (GPL-2.0 OR BSD-3-Clause)
/*
 * Copyright (C) 2023 Lothar Waßmann <LW@KARO-electronics.de>
 */

/dts-v1/;
/plugin/;

&{/chosen} {
	overlays {
		karo-gpu;
	};
};

&epxp {
	status = "okay";
};
